/*
 * Copyright (c) 2026 Converted from swept
 * SPDX-License-Identifier: MIT
 */

#include "corne2_1.dtsi"
#include "corne2_1_common.dtsi"

/* Configuração da matriz de teclas do lado esquerdo (sem offset) */
&kscan0 {
    col-gpios
        = <&pro_micro 21 GPIO_ACTIVE_HIGH>
        , <&pro_micro 20 GPIO_ACTIVE_HIGH>
        , <&pro_micro 19 GPIO_ACTIVE_HIGH>
        , <&pro_micro 18 GPIO_ACTIVE_HIGH>
        , <&pro_micro 15 GPIO_ACTIVE_HIGH>
        , <&pro_micro 14 GPIO_ACTIVE_HIGH>
        ;
};

/* Desativa o I2C local no lado esquerdo, pois o trackpad está na direita */
&pro_micro_i2c {
    status = "disabled";
};

&tps43_split {
    status = "disabled";
};
