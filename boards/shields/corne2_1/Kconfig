## boards/shields/corne2_1/Kconfig
```kconfig
menu "Corne 2.1 shield support"

config SHIELD_CORNE2_1
    bool "Enable Corne 2.1 shield overlays"
    help
      Enable support for Corne 2.1 corne2_1_left / corne2_1_right overlays.

if SHIELD_CORNE2_1

config SHIELD_CORNE2_1_LEFT
    bool "Enable Corne 2.1 left overlay"
    default y

config SHIELD_CORNE2_1_RIGHT
    bool "Enable Corne 2.1 right overlay"
    default y

endif

endmenu
```

## boards/shields/corne2_1/Kconfig.defconfig
```kconfig
if SHIELD_CORNE2_1_LEFT || SHIELD_CORNE2_1_RIGHT

config ZMK_KEYBOARD_NAME
    default "Corne2.1"

endif
```

## boards/shields/corne2_1/Kconfig.shield
```kconfig
config SHIELD_CORNE2_1_LEFT
    def_bool $(shields_list_contains,corne2_1_left)

config SHIELD_CORNE2_1_RIGHT
    def_bool $(shields_list_contains,corne2_1_right)
```
